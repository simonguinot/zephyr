## drivers/led_strip/Kconfig.b1414
```kconfig
# SPDX-License-Identifier: Apache-2.0

config B1414_STRIP
	bool "B1414 LED strip driver"
	help
	  Enable LED strip driver for a daisy chain of B1414 IC devices.

if B1414_STRIP

choice
	prompt "Backend"

config B1414_STRIP_SPI
	bool "SPI"
	depends on SPI
	help
	  This driver uses the MOSI pin of the SPI controller to output a
	  control signal compatible with the B1414 IC. Note that the SPI
	  controller must support a frequency close from 6-7 MHz.

endchoice

endif
```

## dts/bindings/led_strip/b1414.yaml
```yaml
# SPDX-License-Identifier: Apache-2.0

description: |
  Everlight B1414 IC (and compatible) LED controller

  Driver bindings for daisy chains of B1414 IC (and compatible devices
  like SK6812) LED controllers.

  Each bit is described with a 1.2 us pulse

  0 bit: 300 ns high and 900 ns low.
  1 bit: 900 ns high and 300 ns low.

  For each timing a tolerance of +/- 80 ns is supported.

properties:
  chain-length:
    type: int
    required: true
    description: |
      The number of devices in the daisy-chain.
```

## dts/bindings/led_strip/everlight,b1414-spi.yaml
```yaml
# SPDX-License-Identifier: Apache-2.0

description: |
  Everlight B1414 IC LED strip, SPI binding

  Driver bindings to control a daisy chain of B1414 IC (or compatible IC)
  with a SPI master.

  The SPI driver should be usable as long as a zephyr SPI API driver is
  available for your board. Hardware specific tuning is required using
  these properties:

    - spi-max-frequency (must be close from 6-7 MHz)
    - spi-zero-frame
    - spi-one-frame.

  Using this driver implies an 8x internal memory overhead (1 byte of driver
  RAM overhead per bit of pixel data).

compatible: "everlight,b1414-spi"

include: [spi-device.yaml, b1414.yaml]

properties:

  spi-one-frame:
    type: int
    required: true
    description: 8-bit SPI frame to shift out for a 1 pulse.

  spi-zero-frame:
    type: int
    required: true
    description: 8-bit SPI frame to shift out for a 0 pulse.
```
